float data[800]={-0.061998155,-0.111750819,-0.150085204,-0.174802516,-0.194939458,-0.206782147,-0.21022402,-0.212239534,-0.199584152,-0.186277274,-0.166790534,-0.147741362,-0.125589024,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-0.061518919,-0.119891666};
float filtered[800]={0};
float baseadd[800]={0};
int len=800;
float pi=3.141593523;

void normalize(float* sig,int len){
  float maxm=-100000;
  for(int i=0;i<len;i++)
  {
    if(maxm<sig[i])
    maxm=sig[i];
    }
    maxm=abs(maxm);
    for(int i=0;i<len;i++)
    {
      sig[i]=sig[i]/maxm;
      }
  }
  
void setup() {
  Serial.begin(9600);
  // put your setup code here, to run once:
  float mag=1;float f1=0.1;float f2=0.2;float f3=0.25;float fs=80;
  for(int i=0;i<len;i++)
  {
    baseadd[i]=data[i]+mag*(cos((2*pi*f1*i)/fs)+cos((2*pi*f2*i)/fs)+cos((2*pi*f3*i)/fs));
    }
  filtered[0]=0;filtered[1]=0;
  float g=0.98429;float r=0.96858;
  for(int i=2;i<len;i++)
  {
    //High pass
    //filtered[i]=g*(baseadd[i]-baseadd[i-1])-r*filtered[i-1];
    //Band pass till 5Hz
    //filtered[i]=(baseadd[i]-baseadd[i-2]+3.1519*filtered[i-1]-2.4798*filtered[i-2])/2.7933;
    //Band pass till 10Hz
    //filtered[i]=(baseadd[i]-baseadd[i-2]+2.6728*filtered[i-1]-1.7544*filtered[i-2])/2.7933;
    filtered[i]=(1*(baseadd[i]-baseadd[i-2])+1.0728*filtered[i-1]+1.364*filtered[i-2])/2.7933;
    }
    float mse=0,rmse=0,snr=0,x=0;
    for(int i=0;i<len;i++)
    {
      mse=mse+((filtered[i]-data[i])*(filtered[i]-data[i]));
      x=x+(data[i]*data[i]);
      }
      snr=10*log10(x/mse);
      rmse=sqrt(mse/len);
      mse=mse/len;
     /*Serial.print("MSE: ");Serial.print(mse);Serial.println();
      Serial.print("RMSE: ");Serial.print(rmse);Serial.println();
      Serial.print("SNR: ");Serial.print(snr);Serial.print(" dB");Serial.println();*/
      normalize(baseadd,len);
    normalize(filtered,len);
    normalize(data,len);
}

void loop() {
  // put your main code here, to run repeatedly:
  for(int i=0;i<len;i++)
  {
    Serial.print(data[i]);
    Serial.print(',');
    Serial.print(baseadd[i]+10);
    Serial.print(',');
    Serial.println(filtered[i]+20);
    }
}

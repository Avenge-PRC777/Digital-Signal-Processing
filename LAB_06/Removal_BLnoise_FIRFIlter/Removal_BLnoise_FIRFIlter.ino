float data[800]={-221.545324,-232.6856787,-241.1451328,-246.4026453,-250.5699639,-252.7755994,-252.994037,-252.8586921,-249.2709368,-245.5162065,-240.3048294,-235.1908993,-229.3507237,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-147.8695744,-160.7702112};
float filtered[800]={0};
int len=800;

void normalize(float* sig,int len){
  float maxm=-100000;
  for(int i=0;i<len;i++)
  {
    if(maxm<sig[i])
    maxm=sig[i];
    }
    maxm=abs(maxm);
    for(int i=0;i<len;i++)
    {
      sig[i]=sig[i]/maxm;
      }
  }
  
void setup() {
  Serial.begin(9600);
  // put your setup code here, to run once:
  filtered[0]=0;
  float g=0.98429;float r=0.96858;
  for(int i=2;i<len;i++)
  {
    //filtered[i]=g*(data[i]-data[i-1])-r*filtered[i-1];
    //Band pass till 10Hz
    filtered[i]=(data[i]-data[i-2]+2.6728*filtered[i-1]-1.7544*filtered[i-2])/2.7933;
    }
    normalize(filtered,len);
    normalize(data,len);
}

void loop() {
  // put your main code here, to run repeatedly:
  for(int i=0;i<len;i++)
  {
    Serial.print(data[i]);
    Serial.print(',');
    Serial.println(filtered[i])+5;
    }
}
